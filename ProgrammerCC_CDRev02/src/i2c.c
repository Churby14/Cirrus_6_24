//
// ******************************************************************************
//
// Description:     I2C Control Logic
//
// Release History:
//
//  2018-10-12  RLW     Initial Release
//
// ******************************************************************************

#include "global.h"

// ********************************************************************************************************************************
// ********************************************************************************************************************************
//
void HAL_I2C_MemTxCpltCallback(I2C_HandleTypeDef *hi2c) {

    if (hi2c == &hi2c1) {
        I2C1Control.bTxDone = TRUE;
    }
}

// ********************************************************************************************************************************
// ********************************************************************************************************************************
//
void HAL_I2C_MemRxCpltCallback(I2C_HandleTypeDef *hi2c) {

    if (hi2c == &hi2c1) {
        I2C1Control.bRxDone = TRUE;
    }
}

// ********************************************************************************************************************************
// ********************************************************************************************************************************
//
void HAL_I2C_MasterTxCpltCallback(I2C_HandleTypeDef *hi2c) {

    if (hi2c == &hi2c1) {
        I2C1Control.bTxDone = TRUE;
    }
}

// ********************************************************************************************************************************
// ********************************************************************************************************************************
//
void HAL_I2C_MasterRxCpltCallback(I2C_HandleTypeDef *hi2c) {

    if (hi2c == &hi2c1) {
        I2C1Control.bRxDone = TRUE;
    }
}

// ********************************************************************************************************************************
// ********************************************************************************************************************************
//
void I2C_SetMemoryParameters(stI2CControl *I2CControl, uint16_t Address, uint8_t *Buffer, uint16_t Length) {

    I2CControl->Address = Address;
    I2CControl->Buffer = Buffer;
    I2CControl->Length = Length;
}

// ********************************************************************************************************************************
// ********************************************************************************************************************************
//
//  This routine is called from Main Loop every 1mS and reads the MCP3421
//
// HLR-xxxx
// LLR-xxxx
//
void ProcessI2C1(void) {

}

// ********************************************************************************************************************************
// ********************************************************************************************************************************
//
//  This routine is called from Main Loop, or when EEPROM needs to be read or written
//
// HLR-xxxx
// LLR-xxxx
//
void ProcessI2C2(void) {

}

// ********************************************************************************************************************************
// ********************************************************************************************************************************
//
// HLR-xxxx
// LLR-xxxx
//
void I2C_Command(stI2CControl *I2CControl, uint8_t Mode, uint16_t Address, uint8_t *Buffer, uint16_t Length) {

//  uint16_t i;
//  volatile uint32_t Dummy;

}
